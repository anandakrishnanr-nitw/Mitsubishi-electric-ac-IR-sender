//MITSUBISHI_ELECTRIC


/*
 * IRSendRaw.ino   Rev 1
 * Sends raw IR data on D10
 * For Uno, Nano, Pro Mini
 * No libraries needed
 * Sends automatically on boot.  Hit reset to send again.
 * Timing entries fetched directly from flash - PROGMEM
 * Circuit must turn on IR LED when D10 is high
 */

const byte irLED = 10;                                    // Timer 1 "B" output: OC1B
volatile unsigned int irCount;
volatile unsigned int newirCount;
volatile unsigned int irK;
unsigned int oldirK, first1;
byte oldTIMSK0;
unsigned long countDiv, halfDiv;

// raw definition arrays must be global

const unsigned int ON[] PROGMEM = {3374,  1770,   368,  1346,   368,  1348,   369,   467,
   388,   434,   425,   446,   410,  1345,   369,   490,
   367,   470,   388,  1347,   369,  1344,   367,   493,
   366,  1345,   344,   515,   367,   427,   431,  1346,
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   328,   556,   302, 24255
};

const unsigned int OFF[] PROGMEM = { 2703,  1768,   374,  1341,   373,  1342,   373,   466,
   390,   467,   392,   465,   391,  1342,   373,   465,
   392,   486,   372,  1342,   373,  1340,   374,   465,
   393,  1339,   374,   466,   393,   464,   393,  1342,
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   306,  1409,   305
};

const unsigned int A[] PROGMEM = {3393,  1752,   387,  1327,   388,   170,   217,   941,
   387,   470,   386,   382,   477,   463,   392,  1328,
   387,   323,   534,   469,   389,  1328,   386,  1327,
   387,   377,   481,  1326,   388,   363,   494,   468,
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   350,   505,   350, 32814};

const unsigned int B[] PROGMEM = {3376,  1769,   372,  1341,   372,  1342,   371,   470,
   388,   467,   391,   468,   390,  1341,   372,   466,
   391,   467,   390,  1343,   372,  1343,   372,   467,
   391,  1340,   372,   468,   390,   466,   391,  1342,
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   327,   554,   302, 28195
};

const unsigned int C[] PROGMEM = {3374,  1770,   368,  1346,   368,  1348,   369,   467,
   388,   434,   425,   446,   410,  1345,   369,   490,
   367,   470,   388,  1347,   369,  1344,   367,   493,
   366,  1345,   344,   515,   367,   427,   431,  1346,
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   328,   556,   302, 24255

};

const unsigned int D[] PROGMEM = {3395,  1772,   368,  1344,   370,  1345,   369,   468,
   389,   467,   390,   469,   391,  1343,   369,   466,
   391,   468,   390,  1345,   369,  1346,   369,   468,
   389,  1344,   370,   467,   390,   467,   390,  1346,
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   329,   528,   328, 33506};

const unsigned int E[] PROGMEM = {2440,  1705,   447,  1268,   448,  1266,   447,   412,
   447,   411,   444,   412,   446,  1269,   447,   411,
   446,   410,   447,  1267,   446,  1268,   447,   412,
   445,  1268,   449,   410,   444,   411,   446,  1269,
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   278,   578,   280, 36124
};

const unsigned int F[] PROGMEM = {3394,  1768,   370,  1344,   370,  1346,   369,   466,
   390,   467,   392,   463,   391,  1344,   371,   465,
   392,   466,   391,  1346,   370,  1340,   371,   467,
   391,  1342,   372,   466,   391,   465,   391,  1346,
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   147,   738,    99,   733,   144,   710,   147,  4166,
   100};


const unsigned int G[] PROGMEM = {2104,  1345,   369,   468,   389,   468,   389,   468,
   390,   469,   389,  1343,   370,  1346,   368,   468,
   389,   469,   389,   467,   390,   468,   389,   468,
   389,   468,   389,  1345,   371,  1345,   367,   470,
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   304,  1413,   303,  1412,   302
};


const unsigned int H[] PROGMEM = {3395,  1771,   369,  1344,   370,  1344,   370,   467,
   391,   466,   391,   467,   391,  1343,   371,   465,
   391,   467,   391,  1345,   368,  1347,   370,   466,
   390,  1343,   371,   466,   392,   465,   391,  1345,
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   303,   554,   304, 49693


};


const unsigned int I[] PROGMEM = {2172,  1769,   372,  1342,   370,  1344,   371,   465,
   392,   465,   392,   467,   392,  1341,   371,   467,
   391,   465,   393,  1342,   371,  1346,   371,   465,
   392,  1342,   370,   466,   392,   465,   392,  1342,
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   147,  2426,   146,  2451,   100
};


const unsigned int J[] PROGMEM = {3437,  1734,   405,  1310,   404,  1311,   404,   424,
   432,   425,   433,   423,   434,  1288,   428,   423,
   434,   422,   434,  1284,   430,  1311,   404,   424,
   432,  1313,   404,   423,   432,   424,   434,  1284,
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   280,   579,   302, 39408

};


const unsigned int K[] PROGMEM = {3398,  1765,   374,  1341,   375,  1338,   374,   467,
   392,   462,   394,   463,   394,  1340,   375,   411,
   444,   467,   391,  1342,   372,  1341,   374,   462,
   395,  1341,   376,   461,   395,   465,   393,  1339,
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   329,   528,   329, 31172
};



const unsigned int L[] PROGMEM = {3377,  1767,   373,  1340,   373,  1340,   374,   463,
   394,   465,   393,   465,   392,  1343,   372,   466,
   392,   461,   395,  1340,   374,  1341,   373,   467,
   391,  1341,   372,   467,   391,   465,   393,  1340,
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   303,   553,   305, 22902
};


const unsigned int M[] PROGMEM = {3375,  1769,   370,  1346,   370,  1342,   370,   469,
   391,   464,   391,   467,   391,  1344,   369,   468,
   391,   465,   392,  1342,   371,  1345,   370,   467,
   390,  1346,   370,   466,   391,   467,   391,  1342,
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   304,   553,   304, 44737

};


const unsigned int N[] PROGMEM = {3381,  1690,   461,  1318,   406,  1314,   405,   453,
   404,   452,   405,   452,   405,  1309,   404,   453,
   406,   452,   405,  1310,   405,  1308,   404,   454,
   404,  1310,   404,   453,   405,   452,   406,  1310,
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   280,   577,   280, 40655
};

const unsigned int O[] PROGMEM = {3379,  1764,   374,  1341,   375,  1339,   374,   464,
   394,   466,   392,   464,   393,  1339,   375,   464,
   393,   462,   395,  1339,   375,  1342,   373,   466,
   392,  1338,   374,   465,   393,   464,   392,  1341,
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   226,   631,   226, 21675};

const unsigned int P[] PROGMEM = {2218,  1770,   367,  1350,   366,  1346,   368,   449,
   409,   488,   369,   489,   368,  1346,   367,   490,
   368,   392,   465,  1347,   368,  1346,   368,   490,
   367,  1348,   367,   490,   368,   486,   372,  1344,
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   331,   526,   331, 62191
};


const unsigned int FAN_ONE_LOW[] PROGMEM = {3375,  1769,   371,  1344,   371,  1342,   372,   464,
   392,   467,   391,   466,   392,  1341,   372,   466,
   392,   465,   391,  1343,   371,  1344,   371,   467,
   390,  1344,   370,   469,   390,   466,   391,  1341,
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   252,   605,   253, 37472};


const unsigned int FAN_TWO[] PROGMEM = {3348,  1784,   370,  1353,   370,  1346,   371,   466,
   391,   465,   392,   468,   390,  1345,   369,   467,
   390,   468,   389,  1345,   368,  1346,   369,   467,
   390,  1346,   369,   469,   389,   469,   388,  1344,
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   253,   604,   253, 38249
};


const unsigned int FAN_THREE[] PROGMEM = {3377,  1767,   372,  1342,   372,  1342,   373,   465,
   392,   466,   391,   468,   390,  1343,   372,   468,
   390,   463,   392,  1343,   372,  1341,   372,   469,
   389,  1344,   372,   466,   390,   467,   390,  1342,
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   304,   528,   329, 32977
};

const unsigned int FAN_FOUR_HIGH[] PROGMEM = {3374,  1769,   369,  1346,   368,  1346,   369,   467,
   390,   468,   390,   467,   390,  1346,   370,   467,
   390,   466,   389,  1345,   370,  1345,   369,   468,
   390,  1347,   369,   466,   389,   467,   391,  1344,
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   329,   528,   329, 28626
};

  
void setup() {

  pinMode (irLED, OUTPUT); digitalWrite(irLED,LOW);  // D10 normally output low = IR LED off
  pinMode (LED_BUILTIN, OUTPUT);                     // indicator LED
  digitalWrite(LED_BUILTIN,LOW);
  TCCR1A = bit (WGM10) | bit (WGM11);                // fast PWM, normal port
  TCCR1B = bit (WGM12) | bit (WGM13);                // fast PWM, timer stopped
  first1 = 1;                                        // first blob needs adjustment
  TIMSK1 = bit (OCIE1B);                             // enable interrupt - each cycle

  Serial.begin(9600);
  Serial.println("Type to send the IR command.");
}

void loop() {

  if (Serial.available()) {
        String input = Serial.readStringUntil('\n'); // Read input until newline

        if (input.equalsIgnoreCase("on")) { // Check if input is "on"
            sendRaw (ON , sizeof(ON) / sizeof(ON[0]), 38);               // Send an array of raw data, KHz
            Serial.println("AC ON");
        } 

        else if (input.equalsIgnoreCase("off")) { 
            sendRaw(OFF, sizeof(OFF) / sizeof(OFF[0]), 38);
            Serial.println("AC OFF");}

        else if (input.equalsIgnoreCase("16")) { 
            sendRaw(A, sizeof(A) / sizeof(A[0]), 38);
            Serial.println("Temperature = 16°C");}

        else if (input.equalsIgnoreCase("17")) { 
            sendRaw(B, sizeof(B) / sizeof(B[0]), 38);
            Serial.println("Temperature = 17°C");}

        else if (input.equalsIgnoreCase("18")) { 
            sendRaw(C, sizeof(C) / sizeof(C[0]), 38);
            Serial.println("Temperature = 18°C");}

        else if (input.equalsIgnoreCase("19")) { 
            sendRaw(D, sizeof(D) / sizeof(D[0]), 38);
            Serial.println("Temperature = 19°C");}

        else if (input.equalsIgnoreCase("20")) { 
            sendRaw(E, sizeof(E) / sizeof(E[0]), 38);
            Serial.println("Temperature = 20°C");}

        else if (input.equalsIgnoreCase("21")) { 
            sendRaw(F, sizeof(F) / sizeof(F[0]), 38);
            Serial.println("Temperature = 21°C");}

        else if (input.equalsIgnoreCase("22")) { 
            sendRaw(G, sizeof(G) / sizeof(G[0]), 38);
            Serial.println("Temperature = 22°C");}

        else if (input.equalsIgnoreCase("23")) { 
            sendRaw(H, sizeof(H) / sizeof(H[0]), 38);
            Serial.println("Temperature = 23°C");}

        else if (input.equalsIgnoreCase("24")) { 
            sendRaw(I, sizeof(I) / sizeof(I[0]), 38);
            Serial.println("Temperature = 24°C");}

        else if (input.equalsIgnoreCase("25")) { 
            sendRaw(J, sizeof(J) / sizeof(J[0]), 38);
            Serial.println("Temperature = 25°C");}

        else if (input.equalsIgnoreCase("26")) { 
            sendRaw(K, sizeof(K) / sizeof(K[0]), 38);
            Serial.println("Temperature = 26°C");}

        else if (input.equalsIgnoreCase("27")) { 
            sendRaw(L, sizeof(L) / sizeof(L[0]), 38);
            Serial.println("Temperature = 27°C");}

        else if (input.equalsIgnoreCase("28")) { 
            sendRaw(M, sizeof(M) / sizeof(M[0]), 38);
            Serial.println("Temperature = 28°C");}

        else if (input.equalsIgnoreCase("29")) { 
            sendRaw(N, sizeof(N) / sizeof(N[0]), 38);
            Serial.println("Temperature = 29°C");}

        else if (input.equalsIgnoreCase("30")) { 
            sendRaw(O, sizeof(O) / sizeof(O[0]), 38);
            Serial.println("Temperature = 30°C");}

        else if (input.equalsIgnoreCase("31")) { 
            sendRaw(P, sizeof(P) / sizeof(P[0]), 38);
            Serial.println("Temperature = 31°C");}

        else if (input.equalsIgnoreCase("fanone")) { 
            sendRaw(FAN_ONE_LOW, sizeof(FAN_ONE_LOW) / sizeof(FAN_ONE_LOW[0]), 38);
            Serial.println("FAN --- ONE");}

        else if (input.equalsIgnoreCase("fantwo")) { 
            sendRaw(FAN_TWO, sizeof(FAN_TWO) / sizeof(FAN_TWO[0]), 38);
            Serial.println("FAN --- TWO");}

        else if (input.equalsIgnoreCase("fanthree")) { 
            sendRaw(FAN_THREE, sizeof(FAN_THREE) / sizeof(FAN_THREE[0]), 38);
            Serial.println("FAN --- THREE");}


        else if (input.equalsIgnoreCase("fanfour")) { 
            sendRaw(FAN_FOUR_HIGH, sizeof(FAN_FOUR_HIGH) / sizeof(FAN_FOUR_HIGH[0]), 38);
            Serial.println("FAN --- FOUR");}

       
        else {
            Serial.println("Invalid command...");
        }
    }                                          
}

void sendRaw(const unsigned int buf[], unsigned int len, unsigned int hz) {

  oldTIMSK0 = TIMSK0;                                // disable millis interrupt
  TIMSK0 = 0;
  digitalWrite(LED_BUILTIN, HIGH);                   // indicator LED on
  irK = 0;
  oldirK = 0;
  countDiv = (1024000 + (hz/2)) / hz;                // rounded number of hz cycles * 1024
  halfDiv = (countDiv + 1) / 2;                      // half of countDiv
  irCount = Calculate(pgm_read_word_near(buf)) + first1;  // timer count for first value of array
  newirCount = Calculate(pgm_read_word_near(buf+1)); //    and second value
  first1 = 0;
  OCR1A = (((F_CPU/1000) +hz/2) / hz) - 1;           // TOP, zero relative
  OCR1B = OCR1A / 3;                                 // 33% duty cycle
  TCNT1 = OCR1A / 2;                                 // timer count just past OCR1B
  TCCR1A |= bit (COM1B1);                            // clear output on B match
  TCCR1B |= bit (CS10);                              // fast PWM, no prescaler, timer on

  while (irK < len) {
    while (oldirK == irK);                           // wait for interrupt
    if (irK < (len - 1)) newirCount = Calculate (pgm_read_word_near(buf+(irK+1)));
    oldirK = irK;
  }
  TCCR1B &= ~bit(CS10);                              // stop clock
  TCCR1A &= ~bit(COM1B1);                            // disconnect output
  TIMSK0 = oldTIMSK0;                                // re-enable millis
  digitalWrite(LED_BUILTIN, LOW);                    // indicator LED off
}

unsigned int Calculate (unsigned int buf) {          // calculate number of timer cycles
  long temp = buf;
  return ((temp << 10) + halfDiv) / countDiv;
}

ISR(TIMER1_COMPB_vect) {                             // interrupt when output cleared at OCR1B
  irCount--;
  if (irCount == 0) {
    TCCR1A ^= bit (COM1B1);                          // Connect or disconnect D10 to Timer1 output
    irK++;
    irCount = newirCount;                            // get next value
  }
}
